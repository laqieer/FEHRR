INCLUDE ../ldscript/main.lds
INCLUDE ../ldscript/gamecontroller.lds
INCLUDE ../ldscript/msg.lds
INCLUDE ../ldscript/statscreen.lds
INCLUDE ../ldscript/statusscreen.lds
INCLUDE ../ldscript/talk.lds
INCLUDE ../ldscript/text.lds
INCLUDE ../ldscript/texts.lds
INCLUDE ../ldscript/face.lds
INCLUDE ../ldscript/event.lds
INCLUDE ../ldscript/m4a.lds
INCLUDE ../ldscript/unit.lds
INCLUDE ../ldscript/battle.lds
INCLUDE ../ldscript/ai_080326C4.lds
INCLUDE ../ldscript/ai_perform.lds
INCLUDE ../ldscript/ai_phase.lds
INCLUDE ../ldscript/bm.lds
INCLUDE ../ldscript/bmfx.lds
INCLUDE ../ldscript/bmio.lds
INCLUDE ../ldscript/chapter.lds
INCLUDE ../ldscript/chapterinfo.lds
INCLUDE ../ldscript/debugmenu.lds
INCLUDE ../ldscript/eventfunctions.lds
INCLUDE ../ldscript/eventinfo.lds
INCLUDE ../ldscript/helpbox.lds
INCLUDE ../ldscript/helpbox_2.lds
INCLUDE ../ldscript/map.lds
INCLUDE ../ldscript/playerphase.lds
INCLUDE ../ldscript/prepphase.lds
INCLUDE ../ldscript/save_bwl.lds
INCLUDE ../ldscript/save_lib.lds
INCLUDE ../ldscript/save.lds
INCLUDE ../ldscript/trap.lds
INCLUDE ../ldscript/banim.lds
INCLUDE ../ldscript/banim_sprite.lds
INCLUDE ../ldscript/optionmenu.lds
INCLUDE ../ldscript/savescreen.lds
INCLUDE ../ldscript/util.lds
INCLUDE ../ldscript/trademenu.lds
INCLUDE ../ldscript/prepmenu.lds
INCLUDE ../ldscript/save_xmap.lds
INCLUDE ../ldscript/worldmap.lds
INCLUDE ../ldscript/song.lds
INCLUDE ../ldscript/soundroom.lds
INCLUDE ../ldscript/manim.lds
INCLUDE ../ldscript/mu.lds
INCLUDE ../ldscript/savemenu.lds
INCLUDE ../ldscript/titlescreen.lds
INCLUDE ../ldscript/itemuse.lds
INCLUDE ../ldscript/shop.lds
INCLUDE ../ldscript/items.lds
INCLUDE ../ldscript/item.lds
INCLUDE ../ldscript/mapwork.lds
INCLUDE ../ldscript/banim_dragon.lds
INCLUDE ../ldscript/banim_dragonfx_manakete.lds
INCLUDE ../ldscript/unitsprites.lds
